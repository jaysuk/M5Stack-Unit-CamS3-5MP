## main/Kconfig.projbuild
```kconfig
menu "UnitCamS3 Firmware Configuration"

choice UNITCAMS3_CAMERA_BOARD
    prompt "Camera board / sensor"
    default UNITCAMS3_BOARD_PY260
    help
        Selects the pin map and sensor-specific tuning (XCLK, max frame size) this
        build targets. These differ per physical board and are not auto-detected.

    config UNITCAMS3_BOARD_PY260
        bool "M5Stack Unit CamS3-5MP (PY260 sensor)"

    config UNITCAMS3_BOARD_OV3660
        bool "Generic ESP32-S3-CAM, OV3660 sensor (e.g. Goouuu-Cam pinout)"
endchoice

config UNITCAMS3_MQTT_BROKER_URL
    string "MQTT broker URL"
    default "mqtt://your-broker-ip"

config UNITCAMS3_MQTT_USER
    string "MQTT username"
    default ""

config UNITCAMS3_MQTT_PASS
    string "MQTT password"
    default ""

config UNITCAMS3_DEVICE_ID
    string "Device ID (used as MQTT topic prefix and HA entity prefix)"
    default "unitcams3"

config UNITCAMS3_OTA_TOKEN
    string "OTA authentication token"
    default ""
    help
        If non-empty, the MQTT ota/set payload must be JSON {"url":"...","token":"<this>"}
        An empty token disables authentication (accepts bare URL strings, legacy mode).

config UNITCAMS3_COREDUMP_TOKEN
    string "Coredump authentication token"
    default ""
    help
        If non-empty, the GET /api/coredump endpoint requires a Bearer token.
        Add 'Authorization: Bearer <this>' header to your request.
        An empty token disables authentication.

config UNITCAMS3_NEOPIXEL_PIN
    int "NeoPixel (WS2812) ring data pin (GPIO number)"
    default 2
    help
        GPIO driving the WS2812/NeoPixel ring's DIN line. Default GPIO2 is unused by either
        board's camera pin map (see main/main.c's CAM_PIN_* definitions) and isn't a strapping
        pin, but this hasn't been hardware-validated -- confirm against your specific board's
        silkscreen/schematic before wiring, and change this (or via idf.py menuconfig) if GPIO2
        isn't broken out on yours or is already used for something else. Only takes effect if
        "Enable NeoPixel ring" is also ticked on /setup -- boards without the ring wired up
        never touch this pin or the RMT peripheral at all.

config UNITCAMS3_NEOPIXEL_COUNT
    int "NeoPixel ring LED count (default)"
    default 16
    range 1 300
    help
        Default number of WS2812 LEDs in the ring/strip connected to the data pin above. Only
        used to seed the persisted value the first time the device boots (or after a factory
        reset) -- from then on this is overridable at runtime on /setup, same as "Enable
        NeoPixel ring", and takes effect after Save & Restart.

config UNITCAMS3_FPS_TEST_MODE
    bool "FPS test mode (disables Wi-Fi, HTTP, MQTT — camera throughput measurement only)"
    default n
    help
        When enabled the firmware skips all network services and runs the camera
        in a tight loop reporting FPS to the serial console. NEVER enable this
        in production — the device will not stream or respond to MQTT.

endmenu
```
